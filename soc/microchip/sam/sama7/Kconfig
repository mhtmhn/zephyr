## soc/microchip/sam/sama7/Kconfig
```kconfig
# Copyright (C) 2025 Microchip Technology Inc. and its subsidiaries
#
# SPDX-License-Identifier: Apache-2.0
#

config SOC_FAMILY_MICROCHIP_SAMA7
	select MICROCHIP_SAM
	select ARM
	select CPU_CORTEX_A7
	select NEON if !USE_SWITCH
	select VFP_DP_D32_FP16_FMAC if !USE_SWITCH
	select MMU
	select CACHE_MANAGEMENT
```
